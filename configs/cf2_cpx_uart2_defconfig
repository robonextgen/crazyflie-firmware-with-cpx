## configs/cf2_cpx_uart2_defconfig
```kconfig
CONFIG_PLATFORM_CF2=y

# CPX Configuration for UART2: enabled
CONFIG_ENABLE_CPX=y
CONFIG_ENABLE_CPX_ON_UART2=y
CONFIG_CPX_UART2_BAUDRATE=115200
CONFIG_DECK_CPX_HOST_ON_UART2=y
CONFIG_DECK_FORCE="cpxOverUART2"
```
